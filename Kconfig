## Kconfig
```kconfig
menu "OTA Component Configuration"

    config OTA_FIRMWARE_UPGRADE_URL
        string "firmware upgrade url endpoint"
        default ""
        help
            URL of server which hosts the firmware
            image.

endmenu
```

## sdkconfig.defaults
```kconfig
CONFIG_PARTITION_TABLE_TWO_OTA_LARGE=y
CONFIG_BOOTLOADER_COMPILER_OPTIMIZATION_SIZE=y
CONFIG_ESPTOOLPY_FLASHSIZE_4MB=y
CONFIG_HTTPD_MAX_REQ_HDR_LEN=1024
```
